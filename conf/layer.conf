## conf/layer.conf
```bitbake
# We have a conf and classes directory, add to BBPATH
BBPATH .= ":${LAYERDIR}"
# We have recipes-* directories add to bbfiles
BBFILES += "${LAYERDIR}/recipes-*/*/*.bb \
	    ${LAYERDIR}/recipes-*/*/*.bbappend"

BBFILE_COLLECTIONS += "meta-zondax-qemu"
BBFILE_PATTERN_meta-zondax-qemu = "^${LAYERDIR}/"
BBFILE_PRIORITY_meta-zondax-qemu = "6"

LAYERSERIES_COMPAT_meta-zondax-qemu = "hardknott"
PACKAGECONFIG:append:pn-qemu-system-native += " virtfs"
```

## conf/machine/qemu-optee32.conf
```bitbake
# A machine specially configured for optee 32-bit testing.

require conf/machine/include/arm/armv7a/tune-cortexa15.inc
require conf/machine/include/qemu.inc

DEFAULTTUNE = "cortexa15hf"

KERNEL_IMAGETYPE = "zImage"
IMAGE_FSTYPES = "cpio.gz"
SERIAL_CONSOLES = "115200;ttyAMA0 115200;ttyAMA1"
PREFERRED_PROVIDER_virtual/kernel ?= "linux-optee"

EXTRA_IMAGEDEPENDS += "soc-term-native u-boot-optee optee-os tf-a"

UBOOT_MACHINE = "qemu_arm_defconfig"

IMAGE_BOOT_FILES ?= "u-boot.bin"
```

## conf/machine/qemu-optee64.conf
```bitbake
# A machine specially configured for optee 64-bit testing.

require conf/machine/include/arm/armv8a/tune-cortexa57.inc
require conf/machine/include/qemu.inc

KERNEL_IMAGETYPE = "Image"
IMAGE_FSTYPES = "cpio.gz"
SERIAL_CONSOLES = "115200;ttyAMA0 115200;ttyAMA1"
PREFERRED_PROVIDER_virtual/kernel ?= "linux-optee"

EXTRA_IMAGEDEPENDS += "soc-term-native u-boot-optee optee-os tf-a"

UBOOT_MACHINE = "qemu_arm64_defconfig"

IMAGE_BOOT_FILES ?= "u-boot.bin"
```
